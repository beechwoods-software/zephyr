## CMakeLists.txt
```
# SPDX-License-Identifier: Apache-2.0

cmake_minimum_required(VERSION 3.20.0)
find_package(Zephyr REQUIRED HINTS $ENV{ZEPHYR_BASE})
project(led)

target_sources(app PRIVATE src/main.c)
```

## prj.conf
```kconfig
#
# Copyright (c) 2023 Beechwoods Software
#
# SPDX-License-Identifier: Apache-2.0
#

CONFIG_LOG_PROCESS_THREAD_STACK_SIZE=1024
CONFIG_SHELL_STACK_SIZE=2560

CONFIG_NET_LOG=y
#CONFIG_NET_IF_LOG_LEVEL_DBG=y
#CONFIG_NET_PKT_LOG_LEVEL_DBG=y
#CONFIG_WIFI_LOG_LEVEL_DBG=y
#CONFIG_NET_CAPTURE_LOG_LEVEL_DBG=y
#CONFIG_DNS_RESOLVER_LOG_LEVEL_DBG=y

CONFIG_POSIX_API=y


# To use the picowi spi-pio implementation, change the first one to 'n' and the
# second one to 'y'
# Also need to select SPI and SPI_PICO_PIO in drivers/wifi/pico_w_cyw43/src/Kconfig.rpi_pico_w
#CONFIG_BUILD_CYW43_WITH_ZEPHYR_PIO_SPI=y
```

## local.conf
```kconfig
CONFIG_WIFI_SSID=""
CONFIG_WIFI_PSK=""
```

## src/main.c
```c
/*
 * Copyright (c) 2023 Beechwoods Software
 *
 * SPDX-License-Identifier: Apache-2.0
 */

#include <stdio.h>
#include <unistd.h>
#include <zephyr/drivers/led.h>

int main(void)
{
  const struct device *const led_dev = DEVICE_DT_GET_ANY(infineon_cyw43_led);
  if (NULL == led_dev) printf("NULL led_dev\n");
  else printf("+++ led_dev\n");
  int i = 0;
  while (i < 10)
  {
    if (i % 2 == 0) {
        printf("led_on\n");
        led_on(led_dev, 0);
    }
    else {
        printf("led_off\n");
        led_off(led_dev, 0);
    }
    sleep(2);
    i++;
  }
  printf("++++ DONE!\n");
  return 0;
}
```
