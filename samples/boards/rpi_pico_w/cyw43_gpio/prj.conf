## prj.conf
```kconfig
#
# Copyright (c) 2023 Beechwoods Software
#
# SPDX-License-Identifier: Apache-2.0
#

CONFIG_LOG_PROCESS_THREAD_STACK_SIZE=1024
CONFIG_NET_MGMT_EVENT_STACK_SIZE=2048
CONFIG_SHELL_STACK_SIZE=2560

CONFIG_NET_LOG=y
#CONFIG_NET_IF_LOG_LEVEL_DBG=y
#CONFIG_NET_PKT_LOG_LEVEL_DBG=y
#CONFIG_WIFI_LOG_LEVEL_DBG=y
#CONFIG_NET_CAPTURE_LOG_LEVEL_DBG=y
#CONFIG_DNS_RESOLVER_LOG_LEVEL_DBG=y

CONFIG_POSIX_API=y

CONFIG_WIFI=y
CONFIG_WIFI_RPIPICOWCYW43=y

# To use the picowi spi-pio implementation, change the first one to 'n' and the
# second one to 'y'
# Also need to select SPI and SPI_PICO_PIO in drivers/wifi/pico_w_cyw43/src/Kconfig.rpi_pico_w
#CONFIG_BUILD_CYW43_WITH_ZEPHYR_PIO_SPI=y
#CONFIG_USE_PICOWI_PIOSPI=n
CONFIG_BUILD_CYW43_WITH_ZEPHYR_PIO_SPI=n
CONFIG_USE_PICOWI_PIOSPI=y


CONFIG_UART_CONSOLE_DEBUG_SERVER_HOOKS=n

CONFIG_WIFI_RPIPICOWCYW43_SHELL=y

CONFIG_ENTROPY_GENERATOR=y
CONFIG_TEST_RANDOM_GENERATOR=y

CONFIG_NETWORKING=y
CONFIG_NET_L2_ETHERNET=y
CONFIG_INIT_STACKS=y
CONFIG_NET_STATISTICS=y
CONFIG_NET_STATISTICS_WIFI=y
CONFIG_NET_STATISTICS_USER_API=y

CONFIG_NET_SHELL=y
CONFIG_NET_CONFIG_SETTINGS=y
CONFIG_NET_CONFIG_INIT_TIMEOUT=60
CONFIG_NET_CONFIG_AUTO_INIT=n
CONFIG_NET_L2_WIFI_SHELL=y

CONFIG_NET_UDP=y
CONFIG_NET_TCP=y

CONFIG_NET_MGMT=y
CONFIG_NET_MGMT_EVENT=y
CONFIG_WIFI_MGMT_RAW_SCAN_RESULTS=y
CONFIG_NET_MGMT_EVENT_MONITOR=y

CONFIG_NET_IPV6=n
CONFIG_NET_IPV4=y
CONFIG_NET_DHCPV4=y

CONFIG_DNS_RESOLVER=y
CONFIG_DNS_RESOLVER_ADDITIONAL_BUF_CTR=5
CONFIG_DNS_RESOLVER_ADDITIONAL_QUERIES=2
CONFIG_MDNS_RESOLVER=y
CONFIG_DNS_SERVER_IP_ADDRESSES=y
CONFIG_DNS_SERVER1="8.8.8.8"
```

## src/main.c
```c
/*
 * Copyright (c) 2023 Beechwoods Software
 *
 * SPDX-License-Identifier: Apache-2.0
 */

#include <stdio.h>
#include <unistd.h>
#include <zephyr/drivers/led.h>
#include <zephyr/drivers/gpio.h>

int main(void)
{
  const struct device *const gpio_dev = DEVICE_DT_GET_ANY(infineon_cyw43_gpio);
  if (NULL == gpio_dev) printf("NULL gpio_dev\n");
  else printf("+++ gpio_dev\n");
  gpio_port_value_t value = 0;
  gpio_port_clear_bits(gpio_dev, 7);
  gpio_port_get(gpio_dev, &value);
  printf("+++ gpio_port_get -> 0x%x\n", value);
  gpio_port_get_raw(gpio_dev, &value);
  printf("+++ gpio_port_get_raw -> 0x%x\n\n", value);

  printf("+++ Setting pin 0\n");
  gpio_pin_set(gpio_dev, 0, 1);
  gpio_port_get(gpio_dev, &value);
  printf("+++ gpio_port_get -> 0x%x\n", value);
  gpio_port_get_raw(gpio_dev, &value);
  printf("+++ gpio_port_get_raw -> 0x%x\n\n", value);

  printf("+++ Setting pin 1\n");
  gpio_pin_set(gpio_dev, 1, 1);
  gpio_port_get(gpio_dev, &value);
  printf("+++ gpio_port_get -> 0x%x\n", value);
  gpio_port_get_raw(gpio_dev, &value);
  printf("+++ gpio_port_get_raw -> 0x%x\n\n", value);

  printf("+++ Setting pin 2\n");
  gpio_pin_set(gpio_dev, 2, 1);
  gpio_port_get(gpio_dev, &value);
  printf("+++ gpio_port_get -> 0x%x\n", value);
  gpio_port_get_raw(gpio_dev, &value);
  printf("+++ gpio_port_get_raw -> 0x%x\n\n", value);

  printf("+++ Setting pin 3\n");
  gpio_pin_set(gpio_dev, 3, 1);
  gpio_port_get(gpio_dev, &value);
  printf("+++ gpio_port_get -> 0x%x\n", value);
  gpio_port_get_raw(gpio_dev, &value);
  printf("+++ gpio_port_get_raw -> 0x%x\n\n", value);

  printf("+++ gpio_port_set_masked_raw(gpio_dev, 0xf, 0);\n");
  gpio_port_set_masked_raw(gpio_dev, 0xf, 0);
  gpio_port_get(gpio_dev, &value);
  printf("+++ gpio_port_get -> 0x%x\n", value);
  gpio_port_get_raw(gpio_dev, &value);
  printf("+++ gpio_port_get_raw -> 0x%x\n\n", value);

  gpio_pin_set(gpio_dev, 0, 1);
  printf("++ DONE!\n");
  return 0;
}
```
