## CMakeLists.txt
```
# SPDX-License-Identifier: Apache-2.0

cmake_minimum_required(VERSION 3.20.0)
set(EXTRA_CONF_FILE local.conf)
find_package(Zephyr REQUIRED HINTS $ENV{ZEPHYR_BASE})
project(wifi)

target_sources(app PRIVATE src/main.c)
```

## Kconfig
```
config WIFI_SSID
	string "WIFI SSID - Network name"
	default ""

config WIFI_PSK
	string "WIFI PSK - Network password key"
	default ""

source "Kconfig.zephyr"
```

## prj.conf
```kconfig
#
# Copyright (c) 2023 Beechwoods Software
#
# SPDX-License-Identifier: Apache-2.0
#

CONFIG_LOG_PROCESS_THREAD_STACK_SIZE=1024
CONFIG_NET_MGMT_EVENT_STACK_SIZE=2048
CONFIG_SHELL_STACK_SIZE=2560

CONFIG_NET_LOG=y
#CONFIG_NET_IF_LOG_LEVEL_DBG=y
#CONFIG_NET_PKT_LOG_LEVEL_DBG=y
#CONFIG_WIFI_LOG_LEVEL_DBG=y
#CONFIG_NET_CAPTURE_LOG_LEVEL_DBG=y
#CONFIG_DNS_RESOLVER_LOG_LEVEL_DBG=y

CONFIG_POSIX_API=y

CONFIG_WIFI=y
CONFIG_WIFI_RPIPICOWCYW43=y

# To use the picowi spi-pio implementation, change the first one to 'n' and the
# second one to 'y'
# Also need to select SPI and SPI_RPI_PICO_PIO in drivers/wifi/pico_w_cyw43/src/Kconfig.rpi_pico_w
#CONFIG_BUILD_CYW43_WITH_ZEPHYR_PIO_SPI=y
#CONFIG_USE_PICOWI_PIOSPI=n
CONFIG_BUILD_CYW43_WITH_ZEPHYR_PIO_SPI=n
CONFIG_USE_PICOWI_PIOSPI=y


CONFIG_UART_CONSOLE_DEBUG_SERVER_HOOKS=n

CONFIG_WIFI_RPIPICOWCYW43_SHELL=y

CONFIG_ENTROPY_GENERATOR=y
CONFIG_TEST_RANDOM_GENERATOR=y

CONFIG_NETWORKING=y
CONFIG_NET_L2_ETHERNET=y
CONFIG_INIT_STACKS=y
CONFIG_NET_STATISTICS=y
CONFIG_NET_STATISTICS_WIFI=y
CONFIG_NET_STATISTICS_USER_API=y

CONFIG_NET_SHELL=y
CONFIG_NET_CONFIG_SETTINGS=y
CONFIG_NET_CONFIG_INIT_TIMEOUT=60
CONFIG_NET_CONFIG_AUTO_INIT=n
CONFIG_NET_L2_WIFI_SHELL=y

CONFIG_NET_UDP=y
CONFIG_NET_TCP=y

CONFIG_NET_MGMT=y
CONFIG_NET_MGMT_EVENT=y
CONFIG_WIFI_MGMT_RAW_SCAN_RESULTS=y
CONFIG_NET_MGMT_EVENT_MONITOR=y

CONFIG_NET_IPV6=n
CONFIG_NET_IPV4=y
CONFIG_NET_DHCPV4=y

CONFIG_DNS_RESOLVER=y
CONFIG_DNS_RESOLVER_ADDITIONAL_BUF_CTR=5
CONFIG_DNS_RESOLVER_ADDITIONAL_QUERIES=2
CONFIG_MDNS_RESOLVER=y
CONFIG_DNS_SERVER_IP_ADDRESSES=y
CONFIG_DNS_SERVER1="8.8.8.8"

# Powersave parameters
CONFIG_WIFI_RPIPICOWCYW43_POWERSAVE_MODE=0
CONFIG_WIFI_RPIPICOWCYW43_POWERSAVE_PM2_SLEEP_RET_MS=20
CONFIG_WIFI_RPIPICOWCYW43_POWERSAVE_LI_BEACON_PERIOD=1
CONFIG_WIFI_RPIPICOWCYW43_POWERSAVE_LI_DTIM_PERIOD=1
CONFIG_WIFI_RPIPICOWCYW43_POWERSAVE_LI_ASSOC=10
```

## local.conf
```kconfig
CONFIG_WIFI_SSID="cyrus"
CONFIG_WIFI_PSK="6173470125"
```

## src/main.c
```c
/*
 * Copyright (c) 2023 Beechwoods Software
 *
 * SPDX-License-Identifier: Apache-2.0
 */

#include <stdio.h>
#include <unistd.h>
#include <zephyr/net/wifi_mgmt.h>
#include <zephyr/net/net_if.h>
#include <zephyr/net/net_config.h>
#include <zephyr/drivers/led.h>

void wifi_connect(char *ssid, char * passwd) {
    int ret;
    
    struct net_if *iface = net_if_get_default();
    printf("Default interface is %s\n", iface->if_dev->dev->name);
    static struct wifi_connect_req_params req_params = {
        .channel = 0,
        .security = WIFI_SECURITY_TYPE_PSK,
    };
    req_params.ssid = ssid;
    req_params.ssid_length = strlen(ssid);
    req_params.psk = passwd;
    req_params.psk_length = strlen(passwd);
    printf("\n\ncalling net_mgmt(NET_REQUEST_WIFI_CONNECT)\n");
    ret = net_mgmt(NET_REQUEST_WIFI_CONNECT, iface, &req_params, sizeof(struct wifi_connect_req_params));
    printf("%d Finished calling net_mgmt(NET_REQUEST_WIFI_SCAN)\n", ret);
}


int main(void)
{
	/* NET_CONFIG_SETTINGS will init DHCP
	 * NET_SHELL is enabled to test driver and network stack
	 */

  if (strcmp(CONFIG_WIFI_SSID, "") && strcmp(CONFIG_WIFI_PSK, "")) {
    printf("Connecting to network \"%s\"\n", CONFIG_WIFI_SSID);
    wifi_connect(CONFIG_WIFI_SSID, CONFIG_WIFI_PSK);
  }
  else {
    printf("To configure wifi, either:\n");
    printf("\n");
    printf("  1. Run 'wifi connect \"<SSID>\" \"<passphrase>\"' on the command line.\n");
    printf("\n");
    printf("                        - or -\n");
    printf("\n");
    printf("  2. Define CONFIG_WIFI_SSID and CONFIG_WIFI_PSK in local.conf and rebuild.\n");
    printf("\n");
  }
  (void)net_config_init_app(NULL, "Initializing network");
  struct net_if *iface = net_if_get_default();
  if (NULL == iface) printf("NULL iface\n");
  const struct device *const wifidev = DEVICE_DT_GET_ANY(infineon_cyw43);
  if (NULL == wifidev) printf("NULL wifidev\n");
  else printf("+++ wifidev\n");
  const struct device *const led_dev = DEVICE_DT_GET_ANY(infineon_cyw43_led);
  if (NULL == led_dev) printf("NULL led_dev\n");
  else printf("+++ led_dev\n");
  int i = 0;
  while (i < 9)
  {
    if (i % 2 == 0) {
        printf("led_on\n");
        led_on(led_dev, 0);
    }
    else {
        printf("led_off\n");
        led_off(led_dev, 1);
    }
    sleep(2);
    i++;
  }
  printf("++++ DONE!\n");
  return 0;
}
```
