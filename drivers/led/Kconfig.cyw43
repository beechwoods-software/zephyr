## drivers/led/Kconfig.cyw43
```kconfig
config LED_CYW43
	bool "cyw43 LED driver"
	default y
    depends on LED
#    depends on DT_HAS_CYW43_LED_ENABLED
    select I2C
	help
	  Enable the cyw43 LED driver.
```

## drivers/wifi/cyw43/Kconfig.cyw43
```kconfig
# Raspberry Pi Pico W WiFi driver options

# Copyright (c) 2023 Beechwoods Software
# SPDX-License-Identifier: Apache-2.0

menuconfig WIFI_CYW43
	bool "Infineon CYW43 Wifi support"
	default y
	select NET_L2_WIFI_MGMT
	select WIFI_USE_NATIVE_NETWORKING
	select NET_OFFLOAD
	select NET_SOCKETS
	imply NET_SOCKETS_OFFLOAD

	select SPI
	select SPI_RPI_PICO_PIO
	
	#select PICOSDK_USE_DMA
	#select PICOSDK_USE_CLAIM
	#select PICOSDK_USE_GPIO	
	#select PICOSDK_USE_PWM
	
if WIFI_CYW43

config WIFI_CYW43_SHELL
	bool "CYW43 shell"
	depends on SHELL
	help
	  Enable CYW43 shell

config WIFI_CYW43_USE_CYW4343W
	bool "Use Infineon CYW4343W chip"
	help
		Use firmware for the CYW4343W chip in place of
		the CYW43439 on the Raspberry Pi Pico W.

endif
```

## drivers/wifi/pico_w_cyw43/Kconfig.rpi_pico_w
```kconfig
# Raspberry Pi Pico W WiFi driver options

# Copyright (c) 2023 Beechwoods Software
# SPDX-License-Identifier: Apache-2.0

menuconfig WIFI_RPIPICOWCYW43
	bool "Infineon CYW43 Wifi support"
	default y
	select NET_L2_WIFI_MGMT
	select WIFI_USE_NATIVE_NETWORKING
	select NET_OFFLOAD
	select NET_SOCKETS
	imply NET_SOCKETS_OFFLOAD

        #comment these three out to use the picowi pio-spi
	select GPIO
	select SPI # TODO: Seems like the line below should do this too?
	#select SPI_RPI_PICO_PIO
	
        #select PICOSDK_USE_PIO # Temporary until Steve gets his stuff working
	#select PICOSDK_USE_DMA
	#select PICOSDK_USE_CLAIM
	#select PICOSDK_USE_GPIO	
	#select PICOSDK_USE_PWM
	
#if WIFI_RPIPICOWCYW43
config WIFI_RPIPICOWCYW43_SHELL
	bool "CYW43 shell"
	depends on SHELL
	help
	  Enable CYW43 shell

config WIFI_CYW43_USE_CYW4343W
	bool "Use Infineon CYW4343W chip"
	help
		Use firmware for the CYW4343W chip in place of
		the CYW43439 on the Raspberry Pi Pico W.

config USE_PICOWI_PIOSPI
        bool "Use picowi PIO-SPI, but nothing else"
	default n

config BUILD_CYW43_WITH_ZEPHYR_PIO_SPI
        bool "Use Zephyr's PIO SPI bus"
	default n

config LED_INIT_PRIORITY
    int "Wifi led driver init priority"
    default 80

#
#choice WIFI_RPIPICOWCYW43_BUS
#	bool "Select BUS interface"
#	default WIFI_ESWIFI_BUS_PIO_SPI
#
#config WIFI_RPIPICOWCYW43_BUS_PIO_SPI
#	bool "SPI Bus interface"
#	select SPI
#
#endchoice
#
#config WIFI_RPIPICOWCYW43_THREAD_PRIO
#	int "RPIPICOWCYW43 threads priority"
#	default 2
#	help
#	  This option sets the priority of the CYW43 threads.
#	  Do not touch it unless you know what you are doing.
#

#endif
```

## dts/bindings/gpio/raspberrypi,picow-gpio.yaml
```yaml
description: GPIO controller part for the pico w cyw43 bridge

compatible: "raspberrypi,picow-gpio"

include: [gpio-controller.yaml, base.yaml]

properties:
  "#gpio-cells":
    required: true
    const: 2

  ngpios:
    required: true
    const: 8

gpio-cells:
  - pin
  - flags

on-bus: infineon,picow
```

## dts/bindings/led/cyw43,led.yaml
```yaml
description: Infineon cyw43 LED driver for pico_w

compatible: "cyw43,led"

include: i2c-device.yaml
```

## dts/bindings/spi/raspberrypi,pico-spi-pio.yaml
```yaml
# Copyright (c) 2023 Stephen Boylan <stephen.boylan@beechwoods.com>
# SPDX-License-Identifier: Apache-2.0

description: Raspberry Pi Pico SPI via PIO

compatible: "raspberrypi,pico-spi-pio"

include: ["spi-controller.yaml", "raspberrypi,pico-pio-device.yaml", "reset-device.yaml"]

properties:
  reg:
    required: true

  clocks:
    required: true
```

## dts/bindings/wifi/infineon,cyw43.yaml
```yaml
# Copyright (c) 2023, Beechwoods Software, Inc
# SPDX-License-Identifier: Apache-2.0

description: Infineon CYW43 module

compatible: "infineon,cyw43"

include: spi-device.yaml

properties:
  spi-max-frequency:
    type: int
    required: true

  wl-on-gpios:
    type: phandle-array

  wl_host_wake_gpios:
    type: phandle-array
```
